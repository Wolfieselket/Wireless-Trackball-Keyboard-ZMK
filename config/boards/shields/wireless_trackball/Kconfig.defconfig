## config/boards/shields/wireless_trackball/Kconfig.defconfig
```kconfig
if SHIELD_WIRELESS_TRACKBALL_LEFT || SHIELD_WIRELESS_TRACKBALL_RIGHT

config ZMK_KEYBOARD_NAME
    default "WT Trackball"

config ZMK_SPLIT
    default y

endif

if SHIELD_WIRELESS_TRACKBALL_RIGHT

config ZMK_SPLIT_ROLE_CENTRAL
    default y

endif
```

## config/boards/shields/wireless_trackball/Kconfig.shield
```kconfig
config SHIELD_WIRELESS_TRACKBALL_LEFT
    def_bool $(shields_list_contains,wireless_trackball_left)

config SHIELD_WIRELESS_TRACKBALL_RIGHT
    def_bool $(shields_list_contains,wireless_trackball_right)
```
