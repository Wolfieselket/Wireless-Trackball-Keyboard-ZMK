
#include "wireless_trackball.dtsi"
#include <dt-bindings/gpio/gpio.h>

/ {
    kscan0: kscan {
        compatible = "zmk,kscan-gpio-matrix";
        label = "KSCAN";

        diode-direction = "col2row";

        row-gpios = <&pro_micro 0 GPIO_ACTIVE_HIGH>,
                    <&pro_micro 4 GPIO_ACTIVE_HIGH>,
                    <&pro_micro 9 GPIO_ACTIVE_HIGH>,
                    <&pro_micro 10 GPIO_ACTIVE_HIGH>;

        col-gpios = <&pro_micro 14 GPIO_ACTIVE_HIGH>,
                    <&pro_micro 15 GPIO_ACTIVE_HIGH>,
                    <&pro_micro 16 GPIO_ACTIVE_HIGH>,
                    <&pro_micro 18 GPIO_ACTIVE_HIGH>,
                    <&pro_micro 19 GPIO_ACTIVE_HIGH>,
                    <&pro_micro 20 GPIO_ACTIVE_HIGH>;
    };

    chosen {
        zmk,kscan = &kscan0;
    };
};
